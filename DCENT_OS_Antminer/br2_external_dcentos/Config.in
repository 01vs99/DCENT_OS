## DCENT_OS_Antminer/br2_external_dcentos/Config.in
```kconfig
source "$BR2_EXTERNAL_DCENTOS_PATH/packages/dcentos-tools/Config.in"
source "$BR2_EXTERNAL_DCENTOS_PATH/packages/dcentos-deploy-lock/Config.in"
source "$BR2_EXTERNAL_DCENTOS_PATH/packages/dcentos-deploy-path/Config.in"
source "$BR2_EXTERNAL_DCENTOS_PATH/packages/seed-entropy/Config.in"
source "$BR2_EXTERNAL_DCENTOS_PATH/packages/am2-nand-window/Config.in"
```

## DCENT_OS_Antminer/br2_external_dcentos/configs/dcentos_am3_s19jproplus_defconfig
```kconfig
# DCENTos Buildroot override - Antminer S19j Pro+, Amlogic A113D.
# Exact held identity: fw-info model=s19jpro-plus/platform=aml/install_type=nand.
BR2_TARGET_GENERIC_HOSTNAME="dcentos-s19jproplus"
BR2_TARGET_GENERIC_ISSUE="DCENTos Experimental package for exact S19j Pro+ Amlogic identity"
BR2_ROOTFS_OVERLAY="$(BR2_EXTERNAL_DCENTOS_PATH)/board/common/rootfs-overlay $(BR2_EXTERNAL_DCENTOS_PATH)/board/amlogic/rootfs-overlay $(BR2_EXTERNAL_DCENTOS_PATH)/board/amlogic/am3-bm1362-nopic/rootfs-overlay $(BR2_EXTERNAL_DCENTOS_PATH)/board/amlogic/am3-s19jproplus/rootfs-overlay"
BR2_ROOTFS_POST_BUILD_SCRIPT="$(BR2_EXTERNAL_DCENTOS_PATH)/board/amlogic/am3-bm1362-nopic/post-build.sh $(BR2_EXTERNAL_DCENTOS_PATH)/board/common/prune-runtime-research-tools.sh"
BR2_ROOTFS_POST_IMAGE_SCRIPT="$(BR2_EXTERNAL_DCENTOS_PATH)/board/amlogic/am3-s19jproplus/post-image.sh"

BR2_PACKAGE_MTD_UBIATTACH=y
```

## DCENT_OS_Antminer/br2_external_dcentos/packages/am2-nand-window/Config.in
```kconfig
config BR2_PACKAGE_AM2_NAND_WINDOW
	bool "AM2 exact NAND window and native OTA boot tools"
	depends on BR2_arm
	select BR2_PACKAGE_PYTHON3
	help
	  Finite inactive-FPGA NAND writer, complete native boot tuple producer,
	  and redundant environment readback for exact AM2 Zynq images.
```

## DCENT_OS_Antminer/scripts/first_install/am3_bb_recovery_runtime_defconfig
```kconfig
# Independent RAM recovery userspace. No mining overlays or stock init.
BR2_arm=y
BR2_cortex_a8=y
BR2_ARM_ENABLE_NEON=y
BR2_ARM_ENABLE_VFP=y
BR2_ARM_FPU_VFPV3=y
BR2_TOOLCHAIN_EXTERNAL=y
BR2_TOOLCHAIN_EXTERNAL_CUSTOM=y
BR2_TOOLCHAIN_EXTERNAL_DOWNLOAD=y
BR2_TOOLCHAIN_EXTERNAL_URL="https://releases.linaro.org/components/toolchain/binaries/7.2-2017.11/arm-linux-gnueabihf/gcc-linaro-7.2.1-2017.11-x86_64_arm-linux-gnueabihf.tar.xz"
BR2_TOOLCHAIN_EXTERNAL_CUSTOM_PREFIX="arm-linux-gnueabihf"
BR2_TOOLCHAIN_EXTERNAL_GCC_7=y
BR2_TOOLCHAIN_EXTERNAL_HEADERS_4_10=y
BR2_TOOLCHAIN_EXTERNAL_CUSTOM_GLIBC=y
BR2_TOOLCHAIN_EXTERNAL_CXX=y
BR2_TOOLCHAIN_EXTERNAL_FORTRAN=y
BR2_TOOLCHAIN_EXTERNAL_OPENMP=y
BR2_TOOLCHAIN_EXTERNAL_HAS_SSP=y
BR2_TOOLCHAIN_EXTERNAL_HAS_SSP_STRONG=y
BR2_TOOLCHAIN_EXTERNAL_INET_RPC=y
BR2_REPRODUCIBLE=y
BR2_INIT_BUSYBOX=y
BR2_ROOTFS_DEVICE_CREATION_DYNAMIC_DEVTMPFS=y
BR2_TARGET_GENERIC_HOSTNAME="dcent-bb-recovery"
BR2_TARGET_GENERIC_ISSUE="DCENT BBCtrl RAM recovery"
# BR2_TARGET_GENERIC_GETTY is not set
BR2_PACKAGE_BUSYBOX=y
BR2_PACKAGE_PYTHON3=y
BR2_PACKAGE_PYTHON3_ZLIB=y
BR2_PACKAGE_PYTHON3_XZ=y
BR2_PACKAGE_PYTHON3_SSL=y
BR2_PACKAGE_PYTHON3_UNICODEDATA=y
BR2_PACKAGE_PYTHON3_PY_ONLY=y
BR2_PACKAGE_PYTHON_CRYPTOGRAPHY=y
BR2_PACKAGE_DROPBEAR=y
# BR2_PACKAGE_DROPBEAR_CLIENT is not set
# BR2_TARGET_ROOTFS_TAR is not set
BR2_TARGET_ROOTFS_CPIO=y
BR2_TARGET_ROOTFS_CPIO_GZIP=y
```
